## firmware/DVBT_Video_TX/esp32p4/main/Kconfig.projbuild
```kconfig
menu "DVB-T transmitter"
    # Pins as the board is wired. Left alone: GPIO24/25 (USB Serial/JTAG:
    # flashing, console, FPGA updates), GPIO35 (BOOT button), GPIO36 (pulled-up
    # strap); nothing sits on the other strapping pins (34, 37, 38).
    #
    # The RF chain's pins (ADRF6755 CS/CLK/SDI, TXDIS, PA_EN) go to chips on
    # 5V_RF: the firmware leaves them undriven until RF_PWR reads high.

    menu "FPGA stream link (SPI2)"
        config DVBT_FPGA_DREQ
            int "DREQ GPIO"
            default 6
        config DVBT_FPGA_CS
            int "CS GPIO"
            default 7
        config DVBT_FPGA_MOSI
            int "MOSI GPIO"
            default 8
        config DVBT_FPGA_SCK
            int "SCK GPIO"
            default 9
        config DVBT_FPGA_MISO
            int "MISO GPIO"
            default 10
        config DVBT_FPGA_SPI_HZ
            int "Clock (Hz, <= 20 MHz)"
            default 20000000
    endmenu
    menu "FPGA configuration (slave SPI, SPI2 during a load)"
        config DVBT_CFG_PROGRAMN
            int "PROGRAMN GPIO (open drain)"
            default 11
        config DVBT_CFG_INITN
            int "INITN GPIO"
            default 12
        config DVBT_CFG_DONE
            int "DONE GPIO"
            default 13
        config DVBT_CFG_CFG0
            int "CFG0 GPIO"
            default 14
        config DVBT_CFG_CFG1
            int "CFG1 GPIO"
            default 15
        config DVBT_CFG_SN
            int "SN (slave select) GPIO"
            default 28
        config DVBT_CFG_MOSI
            int "D0/MOSI GPIO"
            default 29
        config DVBT_CFG_CCLK
            int "CCLK GPIO"
            default 30
        config DVBT_CFG_MISO
            int "D1/MISO GPIO"
            default 31
        config DVBT_CFG_SSPI_CODE
            int "CFG[1:0] value for slave SPI (confirm in Lattice TN1260)"
            range 0 3
            default 0
        config DVBT_CFG_SPI_HZ
            int "Clock (Hz)"
            default 20000000
    endmenu
    menu "Clocks"
        config DVBT_I2C_SDA
            int "I2C0 SDA GPIO (Si5351A)"
            default 49
        config DVBT_I2C_SCL
            int "I2C0 SCL GPIO (Si5351A)"
            default 50
        config DVBT_SI5351_XTAL_HZ
            int "Si5351A crystal (Hz)"
            default 25000000
        config DVBT_SI5351_LOAD_PF
            int "Si5351A crystal load (6, 8 or 10 pF)"
            default 8
    endmenu
    menu "AD9116 DAC (SPI3, 3-wire)"
        config DVBT_DAC_SCLK
            int "SCLK GPIO"
            default 16
        config DVBT_DAC_SDIO
            int "SDIO GPIO"
            default 17
        config DVBT_DAC_CS
            int "CS GPIO"
            default 19
        config DVBT_DAC_RESET
            int "RESET/PINMD GPIO (needs a board pull-down)"
            default 21
        config DVBT_DAC_SPI_HZ
            int "Clock (Hz, <= 25 MHz)"
            default 10000000
    endmenu
    menu "RF chain (ADRF6755, TCXO, PA: on 5V_RF)"
        config DVBT_RF_PWR
            int "RF_PWR GPIO (5V_RF sense, high when up)"
            default 0
        config DVBT_ADRF_CLK
            int "ADRF6755 CLK GPIO (bit-banged)"
            default 32
        config DVBT_ADRF_SDI
            int "ADRF6755 SDI GPIO"
            default 33
        config DVBT_ADRF_SDO
            int "ADRF6755 SDO GPIO (shared with the DAC bus; input only)"
            default 18
        config DVBT_ADRF_CS
            int "ADRF6755 CS GPIO (MOD_CS)"
            default 20
        config DVBT_ADRF_HALF_NS
            int "ADRF6755 bit-bang half clock period (ns; its SPI allows 20 MHz)"
            default 100
        config DVBT_ADRF_TXDIS
            int "TXDIS GPIO (RF off when high)"
            default 22
        config DVBT_ADRF_LDET
            int "LDET (lock detect) GPIO"
            default 23
        config DVBT_PA_EN
            int "PA_EN GPIO (PA on when high; board pull-down)"
            default 1
        config DVBT_ADRF_REFIN_HZ
            int "ADRF6755 reference (TCXO) frequency (Hz)"
            default 40000000
        config DVBT_ADRF_REFIN_TOL_PPM
            int "Divide the reference below 40 MHz for this much TCXO error (ppm; 0: never)"
            default 0
            help
                0 (the board's choice) runs the PFD at REFIN: 40 MHz, the operating
                point the ADRF6755 datasheet characterises (phase noise, spurs, loop
                filter, the register values of its power-up sequence). A 40 MHz TCXO
                a few ppm fast is a few hundred Hz over the 40 MHz maximum, which the
                part tolerates. A non-zero value sizes the reference divider for
                REFIN + this error instead: with a 40 MHz TCXO that halves the PFD to
                20 MHz, an operating point the datasheet does not characterise.
        config DVBT_TCXO_START_US
            int "TCXO start-up time after 5V_RF comes up (us)"
            default 10000
            help
                The TCXO's enable is the ADRF6755's regulator output, so it starts
                with 5V_RF; the PLL is not programmed until it has. Jauch TCXO
                datasheets give 3 ms (JT32CT, JT21LE) to 10 ms (older JT22C/JT32C
                revisions) maximum; set the fitted part's figure.
        config DVBT_ADRF_ATTEN_DB
            int "ADRF6755 output attenuation (dB, 0-47)"
            range 0 47
            default 0
    endmenu
    menu "Arming"
        config DVBT_ARM
            int "ARM GPIO (high: armed; board pull-down)"
            default 47
        config DVBT_ARM_GATES_RF
            bool "RF on only while armed"
            default y
            help
                RF goes on only while ARM reads high (debounced), and off when it
                goes low; the FPGA, the stream and the SD recording run either way.
                An unplugged cable reads not armed: no RF on the bench by accident.
                Off: ARM is ignored (bench work with no flight computer).
        config DVBT_ARM_MS
            int "ARM debounce (ms)"
            default 20
    endmenu
    config DVBT_LED
        int "Status LED GPIO (active high; -1: none)"
        default 48
    config DVBT_LO_KHZ
        int "Carrier (LO) frequency at boot (kHz)"
        default 1279000
        help
            The channel until the flight computer moves it ($HOP on its UART).
    config DVBT_LO_MIN_KHZ
        int "Lowest carrier allowed (kHz)"
        default 1243500
        help
            The 5.7 MHz signal must stay inside the band: 1240 MHz + 3.5.
    config DVBT_LO_MAX_KHZ
        int "Highest carrier allowed (kHz)"
        default 1296500
    menu "Flight computer UART"
        config DVBT_FC_UART
            int "UART port"
            default 1
        config DVBT_FC_TX
            int "TX GPIO (P4 -> flight computer)"
            default 45
        config DVBT_FC_RX
            int "RX GPIO (flight computer -> P4)"
            default 46
        config DVBT_FC_BAUD
            int "Baud"
            default 115200
    endmenu
    config DVBT_VIDEO
        bool "Camera + H.264 video (needs tools/fetch-video-deps.sh)"
        default y
    config DVBT_CAM_SCCB_SDA
        int "Camera I2C (SCCB) SDA GPIO"
        default 51
    config DVBT_CAM_SCCB_SCL
        int "Camera I2C (SCCB) SCL GPIO"
        default 52
    config DVBT_CAM_EN
        int "Camera enable GPIO (high: on; -1: none)"
        default 54
    config DVBT_CAM_RESET
        int "Camera reset GPIO (-1: none)"
        default -1
    config DVBT_CAM_PWDN
        int "Camera power-down GPIO (-1: none)"
        default -1
    config DVBT_VIDEO_WIDTH
        int "Video width (match the OV5647 format in menuconfig)"
        default 1920
    config DVBT_VIDEO_HEIGHT
        int "Video height"
        default 1080
    config DVBT_VIDEO_KBPS
        int "H.264 bit rate (kbit/s; the channel carries 4147)"
        default 3300
    config DVBT_VIDEO_GOP
        int "Frames between key frames (receiver lock time = GOP / 30 s)"
        default 30
    config DVBT_VIDEO_DELAY_MS
        int "Decoder delay added to the PTS (ms)"
        default 400
    config DVBT_SD_RECORD
        bool "Record the transmitted TS to the SD NAND (ZDSD01GLGEAG)"
        default y
    config DVBT_SD_WIDTH
        int "SD NAND bus width (1 or 4)"
        range 1 4
        default 1
        depends on DVBT_SD_RECORD
    config DVBT_SD_FORMAT
        bool "Format the SD NAND if it has no filesystem (a new board, once)"
        default n
        depends on DVBT_SD_RECORD
        help
            A soldered SD NAND cannot be formatted in a card reader. Build with
            this on once for a new board, then off again: ESP-IDF also formats
            on an internal FatFs error, which a power cut mid-write can leave,
            and that would erase the last flight's recording.
    config DVBT_SD_CLK
        int "SD NAND CLK GPIO"
        default 43
        depends on DVBT_SD_RECORD
    config DVBT_SD_CMD
        int "SD NAND CMD GPIO"
        default 44
        depends on DVBT_SD_RECORD
    config DVBT_SD_D0
        int "SD NAND D0 GPIO (D1-D3 follow it, for 4-bit)"
        default 39
        depends on DVBT_SD_RECORD
    config DVBT_USB_FPGA_UPDATE
        bool "Accept FPGA images over the USB serial port (tools/fpga_update.py)"
        default y
    menu "Per-board RF calibration (bench, spectrum analyser)"
        config DVBT_CAL_DC_I
            int "I DC offset (DAC LSB): null the LO feedthrough"
            range -2048 2047
            default 0
        config DVBT_CAL_DC_Q
            int "Q DC offset (DAC LSB)"
            range -2048 2047
            default 0
        config DVBT_CAL_GAIN_I
            int "I gain, Q2.14 (0: default 2.5 = 40960)"
            range 0 65535
            default 0
        config DVBT_CAL_GAIN_Q
            int "Q gain, Q2.14 (0: default 2.5 = 40960)"
            range 0 65535
            default 0
        config DVBT_CAL_PHASE
            int "I-into-Q phase trim, Q2.14 (null the image)"
            range -32768 32767
            default 0
    endmenu
    config DVBT_HEALTH_MS
        int "Health check period (ms)"
        default 100
    config DVBT_CALLSIGN
        string "Service name in the SDT (your callsign: station ID)"
        default "N0CALL"
endmenu
```
